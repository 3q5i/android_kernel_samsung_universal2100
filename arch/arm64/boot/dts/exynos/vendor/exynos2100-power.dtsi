// SPDX-License-Identifier: GPL-2.0-only
/*
 * Exynos2100 SoC device tree source
 *
 * Copyright (C) 2026 Samsung Electronics Co., Ltd.
 *		http://www.samsung.com
 *
 */

#include "exynos2100-dm.dtsi"
#include "exynos2100-devfreq.dtsi"
#include "exynos2100-thermal.dtsi"

/ {
	acpm_dvfs: acpm_dvfs {
		compatible = "samsung,exynos-acpm-dvfs";
		acpm-ipc-channel = <5>;
	};

	acpm: acpm {
		compatible = "samsung,exynos-acpm";
		#address-cells = <2>;
		#size-cells = <1>;
		acpm-ipc-channel = <4>;
		fvmap_offset = <0xf800>;
		reg = <0x00 0x15830000 0x1000>;
		reg-names = "timer_apm";
		peritimer-cnt = <0xFFFF>;
	};

	exynos_ect: exynos-ect {
		compatible = "samsung,exynos-ect";
		memory-region = <&ect_binary>;
	};
};
